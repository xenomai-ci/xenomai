## kernel/cobalt/arch/arm/Kconfig
```kconfig
source "kernel/xenomai/Kconfig"
source "drivers/xenomai/Kconfig"

config XENO_ARCH_FPU
	def_bool VFP

config XENO_ARCH_SYS3264
	def_bool n

config XENO_ARCH_OUTOFLINE_XNLOCK
	bool
	default y

config XENO_ARCH_IPIPE_COMPAT
	def_bool DOVETAIL
	select IPIPE_COMPAT
```

## kernel/cobalt/arch/arm64/Kconfig
```kconfig
source "kernel/xenomai/Kconfig"
source "drivers/xenomai/Kconfig"

config XENO_ARCH_FPU
	def_bool y

config XENO_ARCH_SYS3264
        def_bool COMPAT
        depends on COMPAT_VDSO

config XENO_ARCH_OUTOFLINE_XNLOCK
       bool
       default y
```

## kernel/drivers/can/c_can/Kconfig
```kconfig
config XENO_DRIVERS_CAN_C_CAN
	depends on XENO_DRIVERS_CAN && OF
	tristate "Bosch C-CAN based chips"

config XENO_DRIVERS_CAN_C_CAN_PLATFORM
	depends on XENO_DRIVERS_CAN_C_CAN
	tristate "Generic Platform Bus based controller"
	help

	This driver adds support for the C_CAN/D_CAN chips connected
	to the "platform bus" (Linux abstraction for directly to the
	processor attached devices) which can be found on various
	boards from ST Microelectronics (http://www.st.com) like the
	SPEAr1310 and SPEAr320 evaluation boards & TI (www.ti.com)
	boards like am335x, dm814x, dm813x and dm811x.
```

## kernel/drivers/can/peak_canfd/Kconfig
```kconfig
config XENO_DRIVERS_CAN_PEAK_CANFD
	depends on XENO_DRIVERS_CAN && PCI && !XENO_DRIVERS_CAN_CALC_BITTIME_OLD
	tristate "PEAK driver for PCAN-PCIe FD family"
	help
	  This driver supports the PCAN-PCIe FD boards family from PEAK-System.
```
